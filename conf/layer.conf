## conf/layer.conf
```bitbake
# We have a conf and classes directory, add to BBPATH
BBPATH .= ":${LAYERDIR}"

# We have a recipes-* directories, add to BBFILES
BBFILES += "${LAYERDIR}/recipes-*/*/*.bb \
	${LAYERDIR}/recipes-*/*/*.bbappend"

BBFILE_COLLECTIONS += "cpc304"
BBFILE_PATTERN_cpc304 = "^${LAYERDIR}/"
BBFILE_PRIORITY_cpc304 = "6"
```

## conf/machine/cpc304.conf
```bitbake
#@TYPE: Machine
#@NAME: cpc304

#@DESCRIPTION: Machine configuration for cpc304 systems


PREFERRED_PROVIDER_virtual/kernel ?= "linux-yocto"
PREFERRED_VERSION_linux-yocto ?= "3.19%"

require conf/machine/include/tune-i586.inc

require conf/machine/include/x86-base.inc

MACHINE_FEATURES += "pcbios screen keyboard pci usbhost ext2 ext3 x86 \
                    acpi serial usbgadget alsa"


MACHINE_EXTRA_RRECOMMENDS += "linux-firmware v86d eee-acpi-scripts kernel-modules"

EXTRA_OECONF_append_pn-matchbox-panel-2 = " --with-battery=acpi"

GLIBC_ADDONS = "nptl"

XSERVER = "xserver-xorg \
           xf86-input-mouse \
           xf86-input-keyboard \
           xf86-input-evdev \
           xf86-input-synaptics \
           xserver-xorg-extension-glx \
           "

APPEND += "lxfb.mode_option=1024x768@60 debugshell=5"
```
